/*
*
* Copyright (c) 2024 The ZMK Contributors
* SPDX-License-Identifier: MIT
*
*/

#include "eyelash_corne.dtsi"
#include <input/processors.dtsi>

/* left_encoder left disabled for this vanilla-zmk display isolation test */